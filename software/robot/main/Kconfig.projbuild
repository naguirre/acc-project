## software/robot/main/Kconfig.projbuild
```kconfig
menu "Robot ACC"

menu "Wifi Configuration"
config LED_PIN
  int "LED GPIO Pin"
  range 0 40
  default 2
  help
    GPIO Connected to LED. Many of the ESP32 development
    boards have one connected to pin 2.


config WIFI_SSID
    string "WiFi SSID"
	default "myssid"
	help
		SSID (network name) to connect to.

config WIFI_PASSWORD
    string "WiFi Password"
	default "myssid"
	help
		WiFi password (WPA or WPA2) to use.

		Can be left blank if the network has no security set.

endmenu

endmenu
```
